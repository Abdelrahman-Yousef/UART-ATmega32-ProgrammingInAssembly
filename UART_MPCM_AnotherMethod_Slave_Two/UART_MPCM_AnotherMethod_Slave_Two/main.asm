;
; UART_MPCM_Slave.asm
;
; Created: 9/4/2023 9:12:41 PM
; Author : Options
;


; Replace with your application code
.INCLUDE "m32def.inc"

.ORG 0x00
MAIN:
LDI R16,HIGH(RAMEND)
OUT SPH,R16
LDI R16,LOW(RAMEND)
OUT SPL,R16

LDI R16,0x00
OUT UBRRH,R16
LDI R16,0x33
OUT UBRRL,R16
LDI R16,0x01
OUT UCSRA,R16
LDI R16,0x84
OUT UCSRC,R16
LDI R16,0x18
OUT UCSRB,R16

LOOP:
CALL RECEIVE_ADDRESS
RJMP LOOP


.ORG 0x100
SEND_DATA:
SBI UCSRA,TXC
OUT UDR,R16
AGAIN: 
SBIS UCSRA,TXC
RJMP AGAIN
RET

RECEIVE_ADDRESS:
SBIS UCSRA,RXC
RJMP RECEIVE_ADDRESS
IN R16,UDR
CALL SEND_DATA
CPI R16,'2'
BREQ HERE
RET
HERE:
LDI R16,0x00
OUT UCSRA,R16
LDI R16,0x86
OUT UCSRC,R16
CALL RECEIVE_DATA
RET

RECEIVE_DATA:
SBIS UCSRA,RXC
RJMP RECEIVE_DATA
IN R16,UDR
CALL SEND_DATA
LDI R16,0x01
OUT UCSRA,R16
LDI R16,0x84
OUT UCSRC,R16
RET
