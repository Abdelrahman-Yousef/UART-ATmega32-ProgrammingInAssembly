;
; UART_MPCM_Master.asm
;
; Created: 9/4/2023 7:59:25 PM
; Author : Options
;


; Replace with your application code

.INCLUDE "m32def.inc"

.ORG 0x00
MAIN:
LDI R16,HIGH(RAMEND)
OUT SPH,R16
LDI R16,LOW(RAMEND)
OUT SPL,R16

LDI R16,0x00
OUT UBRRH,R16
LDI R16,0x33
OUT UBRRL,R16
LDI R16,0x8E
OUT UCSRC,R16
LDI R16,0x0C
OUT UCSRB,R16

LOOP:
LDI R16,'1'
CALL SEND_ADDRESS

LDI R16,'A'
CALL SEND_DATA

LDI R16,'2'
CALL SEND_ADDRESS

LDI R16,'B'
CALL SEND_DATA

RJMP LOOP


.ORG 0x100
SEND_ADDRESS:
SBIS UCSRA,UDRE
RJMP SEND_ADDRESS
SBI UCSRB,TXB8
OUT UDR,R16
RET

SEND_DATA:
SBIS UCSRA,UDRE
RJMP SEND_DATA
CBI UCSRB,TXB8
OUT UDR,R16
RET


