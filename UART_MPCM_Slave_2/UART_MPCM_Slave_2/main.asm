;
; UART_MPCM_Slave.asm
;
; Created: 9/4/2023 9:12:41 PM
; Author : Options
;


; Replace with your application code
.INCLUDE "m32def.inc"

.ORG 0x00
MAIN:
LDI R16,HIGH(RAMEND)
OUT SPH,R16
LDI R16,LOW(RAMEND)
OUT SPL,R16

LDI R16,0x00
OUT UBRRH,R16
LDI R16,0x33
OUT UBRRL,R16
LDI R16,0x01
OUT UCSRA,R16
LDI R16,0x8E
OUT UCSRC,R16
LDI R16,0x1C
OUT UCSRB,R16

LOOP:
CALL RECEIVE_ADDRESS
RJMP LOOP


.ORG 0x100
SEND_DATA:
SBIS UCSRA,UDRE
RJMP SEND_DATA
OUT UDR,R16
RET

RECEIVE_ADDRESS:
SBIS UCSRA,RXC
RJMP RECEIVE_ADDRESS
IN R16,UDR
CALL SEND_DATA
CPI R16,'2'
BREQ HERE
RET
HERE:
CBI UCSRA,MPCM
CALL RECEIVE_DATA
RET

RECEIVE_DATA:
SBIS UCSRA,RXC
RJMP RECEIVE_DATA
IN R16,UDR
CALL SEND_DATA
SBI UCSRA,MPCM
RET
