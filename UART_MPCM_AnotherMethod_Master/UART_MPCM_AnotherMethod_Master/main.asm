;
; UART_MPCM_Master.asm
;
; Created: 9/4/2023 7:59:25 PM
; Author : Options
;


; Replace with your application code

.INCLUDE "m32def.inc"

.ORG 0x00
MAIN:
LDI R16,HIGH(RAMEND)
OUT SPH,R16
LDI R16,LOW(RAMEND)
OUT SPL,R16

LDI R16,0x00
OUT UBRRH,R16
LDI R16,0x33
OUT UBRRL,R16
LDI R16,0x86
OUT UCSRC,R16
LDI R16,0x18
OUT UCSRB,R16

LOOP:
CALL RECEIVE
CPI R16,'A'
BREQ HERE
CALL SEND_DATA
RJMP LOOP
HERE:
CALL SEND_ADDRESS
RJMP LOOP


.ORG 0x100
SEND_ADDRESS:
CALL RECEIVE
L1:
SBIS UCSRA,UDRE
RJMP L1
ORI R16,0x80
OUT UDR,R16
RET

SEND_DATA:
CALL RECEIVE
L2:
SBIS UCSRA,UDRE
RJMP L2
OUT UDR,R16
RET

RECEIVE:
SBIS UCSRA,RXC
RJMP RECEIVE
IN R16,UDR
RET


